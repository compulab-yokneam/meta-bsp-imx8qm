## conf/layer.conf
```bitbake
# We have a conf and classes directory, add to BBPATH
BBPATH .= ":${LAYERDIR}"

# We have recipes-* directories, add to BBFILES
BBFILES += "${LAYERDIR}/recipes-*/*/*.bb \
            ${LAYERDIR}/recipes-*/*/*.bbappend"

BBFILE_COLLECTIONS += "cl-som-imx8max"
BBFILE_PATTERN_cl-som-imx8max = "^${LAYERDIR}/"
BBFILE_PRIORITY_cl-som-imx8max = "6"

BBMASK += "meta-compulab/recipes-xfce"
BBMASK += "meta-compulab/recipes-kernel"
BBMASK += "meta-compulab/recipes-graphics"
BBMASK += ".*boundary.*"

CORE_IMAGE_EXTRA_INSTALL += " kernel-modules "
CORE_IMAGE_EXTRA_INSTALL += "${@bb.utils.contains('DISTRO_CODENAME', 'dunfell', 'firmware-imx-sdma-imx7d', 'firmware-imx-sdma', d)}"

LAYERDEPENDS_cl-som-imx8max = "core"
LAYERSERIES_COMPAT_cl-som-imx8max = "warrior zeus"
```

## conf/machine/cl-som-imx8max.conf
```bitbake
#@TYPE: Machine
#@NAME: Compulab CL-SOM-iMX8MAX
#@SOC: i.MX8QM
#@DESCRIPTION: Machine configuration for CompuLab CL-SOM-iMX8MAX board
#@MAINTAINER: Ilya Ledvich <ilya@compulab.co.il>

MACHINEOVERRIDES =. "mx8:mx8qm:"

require conf/machine/include/imx-base.inc
require conf/machine/include/arm/arch-arm64.inc

#MACHINE_FEATURES_append = " pci optee "
MACHINE_FEATURES_append = " pci "

UBOOT_MAKE_TARGET_cl-som-imx8max = \
    "${@bb.utils.contains('MACHINE_FEATURES', 'optee', '', \
                                                        'u-boot.bin', d)}"
IMXBOOT_TARGETS_SD_cl-som-imx8max = \
    "${@bb.utils.contains('MACHINE_FEATURES', 'optee', 'flash_linux_m4 flash_spl', \
                                                        'flash', d)}"
IMXBOOT_TARGETS_cl-som-imx8max = "${IMXBOOT_TARGETS_SD}"

IMX_BOOT_SEEK_imx8qmmek = "32"

# Don't include kernels in standard images
RDEPENDS_${KERNEL_PACKAGE_NAME}-base = ""

LOADADDR = ""

# We have to disable SERIAL_CONSOLE due to auto-serial-console
SERIAL_CONSOLES = "115200;ttyAMA0"

# we do not want to have getty running on tty1 as we run
# auto-serial-console there
USE_VT = "0"

KERNEL_DEVICETREE = " \
   freescale/imx8qm-sbc-imx8max.dtb \
   freescale/imx8qm-sbc-imx8max-dp.dtb \
   freescale/imx8qm-sbc-imx8max-pcie.dtb \
"

UBOOT_MAKE_TARGET = "u-boot.bin"
UBOOT_SUFFIX = "bin"
UBOOT_CONFIG ??= "sd"
UBOOT_CONFIG[sd] = "cl_som_imx8max_defconfig,sdcard"

IMAGE_BOOTLOADER = "imx-boot"
IMX_BOOT_SEEK = "32"


IMAGE_BOOT_FILES += "hdmitxfw.bin hdmirxfw.bin dpfw.bin"

# Add additional firmware
MACHINE_FIRMWARE_append = " linux-firmware-iwlwifi"
MACHINE_FIRMWARE_append_mx8qm  = " firmware-imx-vpu-imx8 firmware-imx-hdmi firmware-imx-xuvi sof-imx"

# MCore Demo apps to /lib/firmware
MACHINE_EXTRA_RRECOMMENDS_append_mx8qm  = " imx-m4-demos"
```
